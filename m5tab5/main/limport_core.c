/*
 * limport_core.c -- see limport_core.h. No ESP-IDF in it: the AES is
 * decrypt-only and table-driven (IDF 6's Mbed TLS 4 dropped the legacy
 * mbedtls/aes.h and base64.h, and a PSA key per candidate would be far
 * slower), the JSON reader is just enough for config.conf, and the host
 * test in test/limport/ builds this file as it is.
 *
 * SPDX-License-Identifier: MIT
 */
#include "limport_core.h"

#include <string.h>

/* ---- AES-128, decrypt only ---------------------------------------------
 * Tables and rounds as in Defeatist's launcher_import.c. InvMixColumns
 * through the x9/x11/x13/x14 tables, not a bytewise GF multiply: that
 * made a full-image scan take seconds longer (and starved IDLE0). */
static const uint8_t AES_SB[256] = {
0x63,0x7c,0x77,0x7b,0xf2,0x6b,0x6f,0xc5,0x30,0x01,0x67,0x2b,0xfe,0xd7,0xab,0x76,
0xca,0x82,0xc9,0x7d,0xfa,0x59,0x47,0xf0,0xad,0xd4,0xa2,0xaf,0x9c,0xa4,0x72,0xc0,
0xb7,0xfd,0x93,0x26,0x36,0x3f,0xf7,0xcc,0x34,0xa5,0xe5,0xf1,0x71,0xd8,0x31,0x15,
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0x8c,0xa1,0x89,0x0d,0xbf,0xe6,0x42,0x68,0x41,0x99,0x2d,0x0f,0xb0,0x54,0xbb,0x16};
static const uint8_t AES_RCON[11] = {
    0x00,0x01,0x02,0x04,0x08,0x10,0x20,0x40,0x80,0x1b,0x36};

/*
 * InvMixColumns multiply tables (x9, x11, x13, x14 in GF(2^8)) and the
 * inverse S-box, precomputed. The earlier bytewise GF multiply in the
 * hot loop made a full-partition scan take ~16 s on core 0 and tripped
 * the task watchdog on starved IDLE0; table lookups plus the periodic
 * yield in li_scan_part() keep both in check. ~1.25 KB of flash.
 */
static const uint8_t AES_ISB[256] = {
    0x52,0x09,0x6a,0xd5,0x30,0x36,0xa5,0x38,0xbf,0x40,0xa3,0x9e,0x81,0xf3,0xd7,0xfb,
    0x7c,0xe3,0x39,0x82,0x9b,0x2f,0xff,0x87,0x34,0x8e,0x43,0x44,0xc4,0xde,0xe9,0xcb,
    0x54,0x7b,0x94,0x32,0xa6,0xc2,0x23,0x3d,0xee,0x4c,0x95,0x0b,0x42,0xfa,0xc3,0x4e,
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    0x17,0x2b,0x04,0x7e,0xba,0x77,0xd6,0x26,0xe1,0x69,0x14,0x63,0x55,0x21,0x0c,0x7d,
};
static const uint8_t AES_M9[256] = {
    0x00,0x09,0x12,0x1b,0x24,0x2d,0x36,0x3f,0x48,0x41,0x5a,0x53,0x6c,0x65,0x7e,0x77,
    0x90,0x99,0x82,0x8b,0xb4,0xbd,0xa6,0xaf,0xd8,0xd1,0xca,0xc3,0xfc,0xf5,0xee,0xe7,
    0x3b,0x32,0x29,0x20,0x1f,0x16,0x0d,0x04,0x73,0x7a,0x61,0x68,0x57,0x5e,0x45,0x4c,
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    0x31,0x38,0x23,0x2a,0x15,0x1c,0x07,0x0e,0x79,0x70,0x6b,0x62,0x5d,0x54,0x4f,0x46,
};
static const uint8_t AES_M11[256] = {
    0x00,0x0b,0x16,0x1d,0x2c,0x27,0x3a,0x31,0x58,0x53,0x4e,0x45,0x74,0x7f,0x62,0x69,
    0xb0,0xbb,0xa6,0xad,0x9c,0x97,0x8a,0x81,0xe8,0xe3,0xfe,0xf5,0xc4,0xcf,0xd2,0xd9,
    0x7b,0x70,0x6d,0x66,0x57,0x5c,0x41,0x4a,0x23,0x28,0x35,0x3e,0x0f,0x04,0x19,0x12,
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    0xca,0xc1,0xdc,0xd7,0xe6,0xed,0xf0,0xfb,0x92,0x99,0x84,0x8f,0xbe,0xb5,0xa8,0xa3,
};
static const uint8_t AES_M13[256] = {
    0x00,0x0d,0x1a,0x17,0x34,0x39,0x2e,0x23,0x68,0x65,0x72,0x7f,0x5c,0x51,0x46,0x4b,
    0xd0,0xdd,0xca,0xc7,0xe4,0xe9,0xfe,0xf3,0xb8,0xb5,0xa2,0xaf,0x8c,0x81,0x96,0x9b,
    0xbb,0xb6,0xa1,0xac,0x8f,0x82,0x95,0x98,0xd3,0xde,0xc9,0xc4,0xe7,0xea,0xfd,0xf0,
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    0xdc,0xd1,0xc6,0xcb,0xe8,0xe5,0xf2,0xff,0xb4,0xb9,0xae,0xa3,0x80,0x8d,0x9a,0x97,
};
static const uint8_t AES_M14[256] = {
    0x00,0x0e,0x1c,0x12,0x38,0x36,0x24,0x2a,0x70,0x7e,0x6c,0x62,0x48,0x46,0x54,0x5a,
    0xe0,0xee,0xfc,0xf2,0xd8,0xd6,0xc4,0xca,0x90,0x9e,0x8c,0x82,0xa8,0xa6,0xb4,0xba,
    0xdb,0xd5,0xc7,0xc9,0xe3,0xed,0xff,0xf1,0xab,0xa5,0xb7,0xb9,0x93,0x9d,0x8f,0x81,
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    0xd7,0xd9,0xcb,0xc5,0xef,0xe1,0xf3,0xfd,0xa7,0xa9,0xbb,0xb5,0x9f,0x91,0x83,0x8d,
};

static void aes_expand(const uint8_t k[16], uint8_t rk[176]) {
    memcpy(rk, k, 16);
    for (int i = 16; i < 176; i += 4) {
        uint8_t t[4] = { rk[i-4], rk[i-3], rk[i-2], rk[i-1] };
        if (i % 16 == 0) {
            uint8_t tmp = t[0];
            t[0] = AES_SB[t[1]] ^ AES_RCON[i/16];
            t[1] = AES_SB[t[2]]; t[2] = AES_SB[t[3]]; t[3] = AES_SB[tmp];
        }
        for (int j = 0; j < 4; j++) rk[i+j] = rk[i-16+j] ^ t[j];
    }
}
static void aes_inv_shiftrows(uint8_t s[16]) {
    uint8_t t;
    t = s[13]; s[13]=s[9]; s[9]=s[5]; s[5]=s[1]; s[1]=t;
    t = s[2]; s[2]=s[10]; s[10]=t; t=s[6]; s[6]=s[14]; s[14]=t;
    t = s[3]; s[3]=s[7]; s[7]=s[11]; s[11]=s[15]; s[15]=t;
}
static void aes_dec_block(const uint8_t rk[176], const uint8_t in[16], uint8_t out[16]) {
    uint8_t s[16]; memcpy(s, in, 16);
    for (int j = 0; j < 16; j++) s[j] ^= rk[160+j];
    for (int round = 9; round >= 1; round--) {
        aes_inv_shiftrows(s);
        for (int j = 0; j < 16; j++) s[j] = AES_ISB[s[j]];
        for (int j = 0; j < 16; j++) s[j] ^= rk[round*16+j];
        for (int c = 0; c < 4; c++) {                 /* InvMixColumns via tables */
            uint8_t *q = s + c*4, a0=q[0], a1=q[1], a2=q[2], a3=q[3];
            q[0] = AES_M14[a0]^AES_M11[a1]^AES_M13[a2]^AES_M9[a3];
            q[1] = AES_M9[a0]^AES_M14[a1]^AES_M11[a2]^AES_M13[a3];
            q[2] = AES_M13[a0]^AES_M9[a1]^AES_M14[a2]^AES_M11[a3];
            q[3] = AES_M11[a0]^AES_M13[a1]^AES_M9[a2]^AES_M14[a3];
        }
    }
    aes_inv_shiftrows(s);
    for (int j = 0; j < 16; j++) s[j] = AES_ISB[s[j]];
    for (int j = 0; j < 16; j++) s[j] ^= rk[j];
    memcpy(out, s, 16);
}

/* The last block alone: its plaintext is D(ct_last) ^ the block before,
 * and its last byte is the padding length -- a wrong key fails that
 * check 255 times in 256, for one block's work. */
static bool pad_plausible(const uint8_t rk[176], const li_net_t *n)
{
    static const uint8_t iv[16] = { 'L','a','u','n','c','h','e','r','W','i','f','i','K','e','y','!' };
    const uint8_t *last = n->ct + n->ct_len - 16;
    const uint8_t *prev = n->ct_len > 16 ? last - 16 : iv;
    uint8_t blk[16];
    aes_dec_block(rk, last, blk);
    const int pad = blk[15] ^ prev[15];
    if (pad < 1 || pad > 16) return false;
    for (int i = 0; i < pad; i++)
        if ((blk[15 - i] ^ prev[15 - i]) != pad) return false;
    return true;
}

static int decrypt_with(const uint8_t rk[176], const li_net_t *n, char *out, size_t cap)
{
    static const uint8_t iv[16] = { 'L','a','u','n','c','h','e','r','W','i','f','i','K','e','y','!' };
    if (n->ct_len == 0 || n->ct_len % 16 || n->ct_len > LI_CT_MAX || cap <= n->ct_len) return -1;
    uint8_t pt[LI_CT_MAX];
    const uint8_t *prev = iv;
    for (size_t off = 0; off < n->ct_len; off += 16) {
        uint8_t blk[16];
        aes_dec_block(rk, n->ct + off, blk);
        for (int j = 0; j < 16; j++) pt[off + j] = blk[j] ^ prev[j];
        prev = n->ct + off;
    }
    const int pad = pt[n->ct_len - 1];
    if (pad < 1 || pad > 16 || (size_t)pad > n->ct_len) return -1;
    for (int i = 0; i < pad; i++) if (pt[n->ct_len - 1 - i] != pad) return -1;
    const int plen = (int)n->ct_len - pad;
    if (plen < 1) return -1;
    for (int i = 0; i < plen; i++) if (pt[i] < 0x20 || pt[i] > 0x7e) return -1;
    memcpy(out, pt, plen);
    out[plen] = '\0';
    return plen;
}

int li_decrypt_net(const uint8_t key[16], const li_net_t *n, char *out, size_t cap)
{
    uint8_t rk[176];
    aes_expand(key, rk);
    return decrypt_with(rk, n, out, cap);
}

bool li_key_ok(const uint8_t key[16], const li_net_t *nets, int n)
{
    if (n <= 0) return false;
    uint8_t rk[176];
    aes_expand(key, rk);
    if (!pad_plausible(rk, &nets[0])) return false;      /* 255 of 256 end here */
    char pw[LI_CT_MAX + 1];
    for (int i = 0; i < n; i++) {
        const int l = decrypt_with(rk, &nets[i], pw, sizeof pw);
        if (l < LI_MIN_CAND) return false;               /* WPA's 8-character floor */
    }
    return true;
}

bool li_classify(const char *s, bool *is_psk)
{
    const size_t n = strlen(s);
    *is_psk = false;
    if (n == 64) {
        for (size_t i = 0; i < 64; i++) {
            const char c = s[i];
            const bool hex = (c >= '0' && c <= '9') || (c >= 'a' && c <= 'f') || (c >= 'A' && c <= 'F');
            if (!hex) return false;
        }
        *is_psk = true;
        return true;
    }
    return n >= 8 && n <= 63;
}

/* ---- base64 ------------------------------------------------------------- */
int li_b64_decode(const char *s, uint8_t *o, size_t cap)
{
    static const char A[] = "ABCDEFGHIJKLMNOPQRSTUVWXYZabcdefghijklmnopqrstuvwxyz0123456789+/";
    int8_t t[256];
    memset(t, -1, sizeof t);
    for (int i = 0; i < 64; i++) t[(uint8_t)A[i]] = (int8_t)i;
    size_t n = 0;
    int acc = 0, bits = 0;
    for (const char *p = s; *p && *p != '='; p++) {
        const int v = t[(uint8_t)*p];
        if (v < 0) continue;                    /* whitespace, newlines */
        acc = ((acc << 6) | v) & 0xffff;
        bits += 6;
        if (bits >= 8) {
            bits -= 8;
            if (n >= cap) return -1;
            o[n++] = (uint8_t)((acc >> bits) & 0xff);
        }
    }
    return (int)n;
}

/* ---- the key search ------------------------------------------------------ */
static void build_key(const uint8_t *raw, size_t len, uint8_t key[16])
{
    for (int i = 0; i < 16; i++) key[i] = raw[i % len];
}

static bool eval_run(const uint8_t *run, size_t rl, const li_net_t *nets, int nn,
                     uint8_t key_out[16])
{
    if (rl < LI_MIN_CAND) return false;
    for (size_t s = 0; s + LI_MIN_CAND <= rl; s++) {
        uint8_t key[16];
        build_key(run + s, rl - s, key);
        if (li_key_ok(key, nets, nn)) { memcpy(key_out, key, 16); return true; }
    }
    return false;
}

void li_scan_init(li_scan_t *s) { s->rl = 0; }

bool li_scan_feed(li_scan_t *s, const uint8_t *buf, size_t n,
                  const li_net_t *nets, int nn, uint8_t key_out[16])
{
    for (size_t i = 0; i < n; i++) {
        const uint8_t b = buf[i];
        const bool pr = b >= 0x20 && b <= 0x7e;
        if (pr && s->rl < LI_MAX_CAND) {
            s->run[s->rl++] = b;
            continue;
        }
        const bool hit = eval_run(s->run, s->rl, nets, nn, key_out);
        s->rl = 0;
        if (hit) return true;
        if (pr) s->run[s->rl++] = b;            /* a full run starts the next */
    }
    return false;
}

bool li_scan_end(li_scan_t *s, const li_net_t *nets, int nn, uint8_t key_out[16])
{
    const bool hit = eval_run(s->run, s->rl, nets, nn, key_out);
    s->rl = 0;
    return hit;
}

void li_marker_init(li_marker_t *m) { m->k = 0; }

/* The marker's first byte occurs once in it, so a mismatch restarts at
 * 0, or at 1 if that byte is itself the first: no failure table needed. */
bool li_marker_feed(li_marker_t *m, const uint8_t *buf, size_t n)
{
    static const char M[] = LI_MARKER;
    const size_t len = sizeof M - 1;
    for (size_t i = 0; i < n; i++) {
        if (buf[i] == (uint8_t)M[m->k]) m->k++;
        else m->k = buf[i] == (uint8_t)M[0] ? 1 : 0;
        if (m->k == len) { m->k = 0; return true; }
    }
    return false;
}

/* ---- config.conf: just enough JSON ---------------------------------------
 * Strings with their escapes, objects, arrays and the literals; the rest
 * of a value is skipped by structure. Deep nesting is refused. */
typedef struct { const char *p, *end; } js_t;
#define JS_DEPTH 8

static void ws(js_t *j)
{
    while (j->p < j->end && (*j->p == ' ' || *j->p == '\t' || *j->p == '\n' || *j->p == '\r')) j->p++;
}

static int hex4(const char *p, const char *end)
{
    if (end - p < 4) return -1;
    int v = 0;
    for (int i = 0; i < 4; i++) {
        const char c = p[i];
        int d;
        if (c >= '0' && c <= '9') d = c - '0';
        else if (c >= 'a' && c <= 'f') d = c - 'a' + 10;
        else if (c >= 'A' && c <= 'F') d = c - 'A' + 10;
        else return -1;
        v = v * 16 + d;
    }
    return v;
}

static size_t put_utf8(char *o, size_t room, unsigned cp)
{
    char b[4];
    size_t n;
    if (cp < 0x80) { b[0] = (char)cp; n = 1; }
    else if (cp < 0x800) { b[0] = (char)(0xc0 | cp >> 6); b[1] = (char)(0x80 | (cp & 63)); n = 2; }
    else if (cp < 0x10000) { b[0] = (char)(0xe0 | cp >> 12); b[1] = (char)(0x80 | (cp >> 6 & 63)); b[2] = (char)(0x80 | (cp & 63)); n = 3; }
    else { b[0] = (char)(0xf0 | cp >> 18); b[1] = (char)(0x80 | (cp >> 12 & 63)); b[2] = (char)(0x80 | (cp >> 6 & 63)); b[3] = (char)(0x80 | (cp & 63)); n = 4; }
    if (n > room) return 0;
    memcpy(o, b, n);
    return n;
}

/* At the opening quote. Unescaped into out (NUL-terminated); *over is set
 * if it did not fit (out is then cut short). False if the text is damaged. */
static bool js_string(js_t *j, char *out, size_t cap, bool *over)
{
    size_t n = 0;
    *over = false;
    if (j->p >= j->end || *j->p != '"') return false;
    j->p++;
    while (j->p < j->end && *j->p != '"') {
        unsigned char c = (unsigned char)*j->p++;
        char tmp[4];
        size_t tl = 1;
        if (c == '\\') {
            if (j->p >= j->end) return false;
            const char e = *j->p++;
            switch (e) {
            case 'b': tmp[0] = '\b'; break;
            case 'f': tmp[0] = '\f'; break;
            case 'n': tmp[0] = '\n'; break;
            case 'r': tmp[0] = '\r'; break;
            case 't': tmp[0] = '\t'; break;
            case '"': case '\\': case '/': tmp[0] = e; break;
            case 'u': {
                int cp = hex4(j->p, j->end);
                if (cp < 0) return false;
                j->p += 4;
                if (cp >= 0xd800 && cp < 0xdc00) {          /* a surrogate pair */
                    if (j->end - j->p < 6 || j->p[0] != '\\' || j->p[1] != 'u') return false;
                    const int lo = hex4(j->p + 2, j->end);
                    if (lo < 0xdc00 || lo > 0xdfff) return false;
                    j->p += 6;
                    cp = 0x10000 + ((cp - 0xd800) << 10) + (lo - 0xdc00);
                }
                tl = put_utf8(tmp, sizeof tmp, (unsigned)cp);
                break;
            }
            default: return false;
            }
        } else {
            tmp[0] = (char)c;
        }
        if (n + tl >= cap) { *over = true; continue; }
        memcpy(out + n, tmp, tl);
        n += tl;
    }
    if (j->p >= j->end) return false;
    j->p++;                                     /* the closing quote */
    out[n] = '\0';
    return true;
}

static bool js_skip(js_t *j, int depth);

static bool js_skip_container(js_t *j, char close, int depth)
{
    if (depth > JS_DEPTH) return false;
    j->p++;
    ws(j);
    if (j->p < j->end && *j->p == close) { j->p++; return true; }
    for (;;) {
        ws(j);
        if (close == '}') {
            char k[8];
            bool over;
            if (!js_string(j, k, sizeof k, &over)) return false;
            ws(j);
            if (j->p >= j->end || *j->p != ':') return false;
            j->p++;
        }
        if (!js_skip(j, depth + 1)) return false;
        ws(j);
        if (j->p >= j->end) return false;
        if (*j->p == ',') { j->p++; continue; }
        if (*j->p == close) { j->p++; return true; }
        return false;
    }
}

static bool js_skip(js_t *j, int depth)
{
    ws(j);
    if (j->p >= j->end) return false;
    if (*j->p == '"') { char b[2]; bool over; return js_string(j, b, sizeof b, &over); }
    if (*j->p == '{') return js_skip_container(j, '}', depth);
    if (*j->p == '[') return js_skip_container(j, ']', depth);
    const char *s = j->p;                       /* number or literal */
    while (j->p < j->end && *j->p != ',' && *j->p != '}' && *j->p != ']' &&
           *j->p != ' ' && *j->p != '\t' && *j->p != '\n' && *j->p != '\r') j->p++;
    return j->p > s;
}

typedef struct { li_net_t *nets; int cap, n, skipped; } collect_t;

/* One element of the wifi array. False if the text is damaged. */
static bool js_entry(js_t *j, collect_t *c)
{
    char ssid[64] = "", pwd[160] = "";
    bool secure = true, have_pwd = false, ssid_over = false, pwd_over = false;
    ws(j);
    if (j->p >= j->end || *j->p != '{') return js_skip(j, 2) && (c->skipped++, true);
    j->p++;
    ws(j);
    if (j->p < j->end && *j->p == '}') { j->p++; c->skipped++; return true; }
    for (;;) {
        char key[16];
        bool kover;
        ws(j);
        if (!js_string(j, key, sizeof key, &kover)) return false;
        ws(j);
        if (j->p >= j->end || *j->p != ':') return false;
        j->p++;
        ws(j);
        if (!strcmp(key, "ssid") && !kover && j->p < j->end && *j->p == '"') {
            if (!js_string(j, ssid, sizeof ssid, &ssid_over)) return false;
        } else if (!strcmp(key, "pwd") && !kover && j->p < j->end && *j->p == '"') {
            if (!js_string(j, pwd, sizeof pwd, &pwd_over)) return false;
            have_pwd = true;
        } else if (!strcmp(key, "secure") && !kover) {
            if (j->end - j->p >= 5 && !memcmp(j->p, "false", 5)) { secure = false; j->p += 5; }
            else if (!js_skip(j, 2)) return false;
        } else if (!js_skip(j, 2)) {
            return false;
        }
        ws(j);
        if (j->p >= j->end) return false;
        if (*j->p == ',') { j->p++; continue; }
        if (*j->p == '}') { j->p++; break; }
        return false;
    }

    li_net_t net;
    memset(&net, 0, sizeof net);
    const size_t sl = strlen(ssid);
    if (sl == 0 || sl > LI_SSID_MAX || ssid_over || !secure || !have_pwd || pwd_over || !pwd[0]) {
        c->skipped++;
        return true;
    }
    const int ctl = li_b64_decode(pwd, net.ct, sizeof net.ct);
    if (ctl <= 0 || ctl % 16) { c->skipped++; return true; }
    if (c->n >= c->cap) { c->skipped++; return true; }
    memcpy(net.ssid, ssid, sl + 1);
    net.ct_len = (size_t)ctl;
    c->nets[c->n++] = net;
    return true;
}

/* Find the first "wifi" key whose value is an array, anywhere in the
 * document, and read its entries. 1 found, 0 not in this value, -1 damaged. */
static int js_find_wifi(js_t *j, collect_t *c, int depth)
{
    ws(j);
    if (j->p >= j->end || depth > JS_DEPTH) return -1;
    if (*j->p == '[') {
        j->p++;
        ws(j);
        if (j->p < j->end && *j->p == ']') { j->p++; return 0; }
        for (;;) {
            const int r = js_find_wifi(j, c, depth + 1);
            if (r != 0) return r;
            ws(j);
            if (j->p >= j->end) return -1;
            if (*j->p == ',') { j->p++; continue; }
            if (*j->p == ']') { j->p++; return 0; }
            return -1;
        }
    }
    if (*j->p == '{') {
        j->p++;
        ws(j);
        if (j->p < j->end && *j->p == '}') { j->p++; return 0; }
        for (;;) {
            char key[16];
            bool over;
            ws(j);
            if (!js_string(j, key, sizeof key, &over)) return -1;
            ws(j);
            if (j->p >= j->end || *j->p != ':') return -1;
            j->p++;
            ws(j);
            if (!over && !strcmp(key, "wifi") && j->p < j->end && *j->p == '[') {
                j->p++;
                ws(j);
                if (j->p < j->end && *j->p == ']') { j->p++; return 1; }
                for (;;) {
                    if (!js_entry(j, c)) return -1;
                    ws(j);
                    if (j->p >= j->end) return -1;
                    if (*j->p == ',') { j->p++; continue; }
                    if (*j->p == ']') { j->p++; return 1; }
                    return -1;
                }
            }
            const int r = js_find_wifi(j, c, depth + 1);
            if (r != 0) return r;
            ws(j);
            if (j->p >= j->end) return -1;
            if (*j->p == ',') { j->p++; continue; }
            if (*j->p == '}') { j->p++; return 0; }
            return -1;
        }
    }
    return js_skip(j, depth) ? 0 : -1;          /* a scalar */
}

int li_parse_config(const char *json, size_t len, li_net_t *nets, int cap, int *skipped)
{
    js_t j = { json, json + len };
    collect_t c = { nets, cap, 0, 0 };
    const int r = js_find_wifi(&j, &c, 0);
    if (skipped) *skipped = c.skipped;
    return r == 1 ? c.n : -1;
}
